## ev-esp32-rc522-0625/components/mqtt-client/Kconfig.projbuild
```kconfig
menu "MQTT Configuration"

    config BROKER_URL
        string "Broker URL"
        default "mqtt://192.168.1.12:1883"
        help
            URL of the broker to connect to

    config TELEMETRY_TOPIC_NAME
        string "Telemetry topic name template"
        default "/v1/devices/%s/telemetry"
        help
            Name of the telemetry topic

    config REGISTRATION_TOPIC_NAME
        string "Device registration topic name template"
        default "/v1/devices/%s/register"
        help
            Name of the device registration topic

endmenu
```

## ev-esp32-rc522-0625/components/wifi/Kconfig.projbuild
```kconfig
menu "WiFi Provisioning Configuration"

    config EXAMPLE_RESET_PROVISIONED
        bool
        default n
        prompt "Reset provisioned status of the device"
        help
            This erases the NVS to reset provisioned status of the device on every reboot.
            Provisioned status is determined by the Wi-Fi STA configuration, saved on the NVS.

    config EXAMPLE_RESET_PROV_MGR_ON_FAILURE
        bool
        default y
        prompt "Reset provisioned credentials and state machine after session failure"
        help
            Enable resetting provisioned credentials and state machine after session failure.
            This will restart the provisioning service after retries are exhausted.

endmenu
```
